## esp32_oled/main/Kconfig.projbuild
```kconfig
menu "ESP32-C5 camera viewer"

    config APP_AP_SSID
        string "SoftAP SSID"
        default "ESP32-C5-CAM"
        help
            Name of the access point the ESP32-CAM joins. Keep it in sync with
            CONFIG_APP_WIFI_STA_SSID on the camera firmware.

    config APP_AP_HIDDEN
        bool "Hide the SoftAP SSID"
        default y
        help
            A hidden AP does not answer scans; stations (and phones) must be
            told the SSID explicitly. The camera joins by SSID, so it is not
            affected.

    config APP_AP_PASSWORD
        string "SoftAP password (at least 8 characters)"
        default "c5cam12345"
        help
            WPA2 password for the access point. Shorter values open an
            unencrypted network, which the camera still joins.

    config APP_UDP_PORT
        int "UDP port the camera sends to"
        range 1024 65535
        default 5000
        help
            Must match the camera's CONFIG_APP_UDP_PORT.

    config APP_AP_CHANNEL
        int "SoftAP channel"
        range 1 13
        default 6
        help
            Channel of the 2.4 GHz access point. 1, 6 and 11 do not overlap;
            pick whichever is quietest where the board is installed. A busy
            channel shows up as a low frame rate.

    config APP_BUTTON_GPIO
        int "Button GPIO (IO0 by default)"
        range 0 28
        default 0
        help
            The viewer board's BOOT/IO0 button. On some boards the BOOT button
            is wired to a different pin; set it here.

    config APP_BUTTON_ACTIVE_LOW
        bool "Button pulls the GPIO low when pressed"
        default y

    config APP_VIEW_GAIN
        int "Display brightness gain (percent)"
        range 50 300
        default 110
        help
            Multiplies the grey value before it is reduced to one bit. Useful
            for dim scenes on the small panel.

    config APP_VIEW_DITHER
        bool "Floyd-Steinberg dithering"
        default y
        help
            Spreads the grey error over neighbouring pixels. Without dithering
            every pixel above mid-grey is lit, which loses most of the detail.

endmenu
```

## esp32cam/main/Kconfig.projbuild
```kconfig
menu "ESP32-CAM"

    choice APP_WIFI_MODE
        prompt "Network mode"
        default APP_WIFI_MODE_STA

        config APP_WIFI_MODE_STA
            bool "Join the viewer's network and keep retrying"

        config APP_WIFI_MODE_AP
            bool "Always run a SoftAP"
    endchoice

    config APP_WIFI_STA_SSID
        string "SSID of the network to join"
        default ""
        help
            Leave empty to always start the SoftAP. Must match the viewer's
            CONFIG_APP_AP_SSID (the ESP32-C5 image defaults to ESP32-C5-CAM).

    config APP_WIFI_STA_PASSWORD
        string "Password of the network to join"
        default ""
        help
            Must match the viewer's CONFIG_APP_AP_PASSWORD.

    config APP_WIFI_AP_SSID
        string "SoftAP SSID"
        default "ESP32-CAM"
        help
            Name of the access point the camera opens.

    config APP_WIFI_AP_PASSWORD
        string "SoftAP password (at least 8 characters)"
        default "esp32cam123"
        help
            WPA2 password for the access point. Shorter values open an
            unencrypted network.

    choice APP_JPEG_SIZE
        prompt "JPEG frame size (/jpg, MJPEG stream, web UI)"
        default APP_JPEG_QQVGA
        help
            The viewer panel is only 128x64, and smaller frames are the
            cheapest way to raise the frame rate over Wi-Fi.

        config APP_JPEG_QQVGA
            bool "QQVGA 160x120 (lighter, faster)"

        config APP_JPEG_QVGA
            bool "QVGA 320x240 (more detail)"
    endchoice

    choice APP_UDP_SOURCE
        prompt "Frames fed to the UDP sender"
        default APP_UDP_SOURCE_JPEG
        help
            YUV422 raw lets the sender sample the luma plane directly: no JPEG
            decode, no RGB565 buffer. JPEG keeps the web UI in MJPEG but costs
            a decode per frame.

        config APP_UDP_SOURCE_RAW
            bool "YUV422 raw, luma sampled directly"
            help
                The OV2640 only produces ~13.5 fps in YUV422 QQVGA with this
                driver, so this is slower than the JPEG path in practice.

        config APP_UDP_SOURCE_JPEG
            bool "JPEG, decoded on the camera (recommended)"
    endchoice

    config APP_UDP_ENABLE
        bool "Send panel-sized grey frames to the viewer over UDP"
        default y
        help
            The camera decodes its own JPEG frames, reduces them to the
            panel's 128x64 and sends that over UDP. The viewer then only has
            to draw, and the link carries 8.2 kB per frame instead of the
            camera's JPEG.

    config APP_UDP_HOST
        string "Viewer address"
        default "192.168.4.1"
        depends on APP_UDP_ENABLE
        help
            The viewer is the access point, so its address is the AP's IP.

    config APP_UDP_PORT
        int "Viewer UDP port"
        default 5000
        range 1024 65535
        depends on APP_UDP_ENABLE

    config APP_FLASH_DARK_AEC
        int "Turn the flash on above this sensor AEC value"
        range 0 1200
        default 600
        help
            OV2640 exposure value (0-1200): rises in dim light. The light is
            switched on when the scene stays darker than this.

    config APP_FLASH_BRIGHT_AEC
        int "Turn the flash off below this sensor AEC value"
        range 0 1200
        default 250
        help
            With the light on, a bright scene drives the exposure below this
            value, so the light is no longer needed.

    config APP_FLASH_DWELL_MS
        int "Minimum milliseconds between flash changes"
        range 500 30000
        default 3000

    config APP_UDP_ADAPT
        bool "Adapt the send interval from the viewer's fps feedback"
        default y
        help
            Disable to keep a fixed interval, e.g. to measure the pipeline's
            ceiling with APP_UDP_INTERVAL_MS=0.

    config APP_UDP_TARGET_FPS
        int "Viewer fps the sender paces itself to"
        range 10 60
        default 40
        depends on APP_UDP_ADAPT
        help
            Frame period / target is the sleep budget, and the viewer's measured
            fps trims it by a millisecond per second. 20 is the comfortable
            number; 40 needs the I2C overclock on the viewer side.

    config APP_UDP_GRAY_SCALE
        int "tjpgd decode scale (0 = full size, 1 = half)"
        range 0 1
        default 0
        depends on APP_UDP_SOURCE_JPEG
        help
            Full size costs about 3 ms per frame (encode 14-15 -> 17-18 ms) and
            still holds 40 fps, so it is the default: the panel gets 160x120
            samples from a 160x80 centre crop instead of 80x40 enlarged 1.6x.
            Half size is the fallback if the CPU budget is needed elsewhere.

    config APP_UDP_AUTO_QUALITY
        bool "Spend idle frame time on sensor JPEG quality"
        default y
        depends on APP_UDP_ADAPT
        help
            Steps the sensor from JPEG quality 12 to 9 to 7 while the pacing
            loop still has at least 2 ms of idle time and the viewer holds the
            target fps. A step that drops the viewer below target is reverted
            and the next attempt waits twice as long.

    config APP_UDP_INTERVAL_MS
        int "Milliseconds between sent frames"
        default 10
        range 0 2000
        depends on APP_UDP_ENABLE
        help
            Starting interval, replaced by period - measured work on the first
            five-second window.

endmenu
```
